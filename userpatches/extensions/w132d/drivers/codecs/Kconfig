## userpatches/extensions/w132d/drivers/codecs/Kconfig
```kconfig
# SPDX-License-Identifier: GPL-2.0-only
config SND_SOC_RK3528
	tristate "Rockchip RK3528 internal codec"
	depends on ARCH_ROCKCHIP && OF
	select REGMAP_MMIO
config SND_SOC_ES7202
	tristate "Everest ES7202 PDM ADC for W132D"
	depends on I2C
	select REGMAP_I2C

config SND_SOC_ES7202_MIC_MAX_CHANNELS
	int
	default 2
	depends on SND_SOC_ES7202
```

## userpatches/extensions/w132d/drivers/uwe5621ds/Kconfig
```kconfig
config SPARD_WLAN_SUPPORT
	bool "W132D UWE5621DS SDIO support"
	depends on ARCH_ROCKCHIP && MMC && BT && CFG80211
	select RK_WIFI_DEVICE_UWE5621DS if ARCH_ROCKCHIP
	help
	  This is support for spreadtrum wireless chip.

if SPARD_WLAN_SUPPORT
source "drivers/net/wireless/uwe5621ds/unisocwcn/Kconfig"
source "drivers/net/wireless/uwe5621ds/unisocwifi/Kconfig"
source "drivers/net/wireless/uwe5621ds/tty-sdio/Kconfig"
endif
```

## userpatches/extensions/w132d/drivers/uwe5621ds/tty-sdio/Kconfig
```kconfig
config TTY_OVERY_SDIO
	tristate "Spard TTY Overy SDIO Driver"
	help
	  Spard tty overy sdio driver.

config TTY_OVERY_SDIO_HCI
	bool "Register the Bluetooth channel as an HCI device instead of a tty"
	depends on TTY_OVERY_SDIO && BT
	help
	  Register a Bluetooth HCI device (hci0) directly on the marlin SDIO
	  channel and do the Marlin3E vendor initialisation (pskey, RF
	  parameters, enable) in the kernel, like upstream SDIO Bluetooth
	  drivers do. Without this the channel is exposed as /dev/ttyBT0 and
	  userspace has to send the vendor commands and attach the H4 line
	  discipline itself.
```

## userpatches/extensions/w132d/drivers/uwe5621ds/unisocwifi/Kconfig
```kconfig
config WLAN_UWE5621DS
	tristate "UWE5621DS Wi-Fi Driver"
	help
	  Spard UWE5621DS Wi-Fi Driver.

config SPRDWL_NG
	tristate "SPRD Next Generation Wireless LAN Support"
	depends on CFG80211
	help
	  This is a driver for the Spreadtrum IEEE802.11 WLAN devices.

	  When compiled as a module, this driver will be called sprdwl_ng.

config UNISOC_WIFI_PS
	bool "Unisoc Wi-Fi Power Save Support"
	depends on WLAN_UWE5621DS
        help
          Spard UWE5621DS Wi-Fi Driver Power Save.
```
